// kinedactyl_lh.overlay

#include "kinedactyl.dtsi" // Notice that the main dtsi files are included in the overlay.


&default_transform { // The matrix transform for this board is 8 columns over because the left half is 8 columns wide according to the matrix.
    col-offset = <8>;
};

&kscan0 {
    col-gpios
      = <&pro_micro 3  GPIO_ACTIVE_HIGH > // Col 8  from the schematic file
      , <&pro_micro 4  GPIO_ACTIVE_HIGH > // Col 9  from the schematic file
      , <&pro_micro 5  GPIO_ACTIVE_HIGH > // Col 10 from the schematic file
      , <&pro_micro 6  GPIO_ACTIVE_HIGH > // Col 11 from the schematic file
      , <&pro_micro 7  GPIO_ACTIVE_HIGH > // Col 12 from the schematic file
      , <&pro_micro 8  GPIO_ACTIVE_HIGH > // Col 13 from the schematic file
      , <&pro_micro 9  GPIO_ACTIVE_HIGH > // Col 14 from the schematic file
      , <&pro_micro 20 GPIO_ACTIVE_HIGH > // Col 15 from the schematic file
            ;
};
