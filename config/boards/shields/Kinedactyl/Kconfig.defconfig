## config/boards/shields/Kinedactyl/Kconfig.defconfig
```kconfig
if SHIELD_Kinedactyl_LH

config ZMK_KEYBOARD_NAME
    default "Kinedactyl"

config ZMK_SPLIT_ROLE_CENTRAL
    default y

endif

if SHIELD_Kinedactyl_LH || SHIELD_Kinedactyl_RH

config ZMK_SPLIT
    default y

endif
```

## config/boards/shields/Kinedactyl/kconfig.shield
```kconfig
config SHIELD_Kinedactyl_LH
    def_bool $(shields_list_contains,Kinedactyl_LH)

config SHIELD_Kinedactyl_RH
    def_bool $(shields_list_contains,Kinedactyl_RH)
```

## config/boards/shields/kinedactyl/Kconfig.defconfig
```kconfig
if SHIELD_kinedactyl_lh

config ZMK_KEYBOARD_NAME
    default "kinedactyl"

config ZMK_SPLIT_ROLE_CENTRAL
    default y

endif

if SHIELD_kinedactyl_lh || SHIELD_kinedactyl_rh

config ZMK_SPLIT
    default y

endif
```

## config/boards/shields/kinedactyl/Kconfig.shield
```kconfig
# Copyright (c) 2022 The ZMK Contributors
# SPDX-License-Identifier: MIT

config SHIELD_kinedactyl_lh
    def_bool $(shields_list_contains,kinedactyl_lh)

config SHIELD_kinedactyl_rh
    def_bool $(shields_list_contains,kinedactyl_rh)
```

## config/boards/shields/kinedactyl/kconfig.shield
```kconfig
config SHIELD_Kinedactyl_LH
    def_bool $(shields_list_contains,kinedactyl_lh)

config SHIELD_Kinedactyl_RH
    def_bool $(shields_list_contains,kinedactyl_rh)
```
